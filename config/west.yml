## config/west.yml
```yaml
manifest:
  defaults:
    revision: v0.3
  remotes:
    - name: zmkfirmware
      url-base: https://github.com/zmkfirmware
    - name: ssbb
      url-base: https://github.com/ssbb
    - name: urob
      url-base: https://github.com/urob
    - name: gpeye
      url-base: https://github.com/GPeye
    - name: Ziembski
      url-base: https://github.com/Ziembski
    # Additional modules containing boards/shields/custom code can be listed here as well
    # See https://docs.zephyrproject.org/3.2.0/develop/west/manifest.html#projects
  projects:
    - name: zmk
      remote: zmkfirmware
      import: app/west.yml
    - name: zmk-antecedent-morph
      remote: ssbb
      revision: v1
    - name: zmk-auto-layer
      remote: urob
      revision: main
    - name: hammerbeam-slideshow
      remote: gpeye
      revision: main
    - name: nice-view-press-start
      remote: Ziembski
      revision: main
  self:
    path: config
```
